## custom_defconfigs/b4q_defconfig
```kconfig
# Disable Werror
CONFIG_WERROR=n

# Add LOCALVERSION
CONFIG_LOCALVERSION="-ChicletKernel-UPSTREAM"
# CONFIG_LOCALVERSION_AUTO is not set

# Enable TMPFS_XATTR for HybridMount
CONFIG_TMPFS_POSIX_ACL=y
CONFIG_TMPFS_XATTR=y

# Multi-Gen LRU
CONFIG_LRU_GEN=y
CONFIG_LRU_GEN_ENABLED=y

# TCP
CONFIG_TCP_CONG_ADVANCED=y
# CONFIG_TCP_CONG_BIC is not set
# CONFIG_TCP_CONG_WESTWOOD is not set
# CONFIG_TCP_CONG_HTCP is not set
CONFIG_TCP_CONG_BBR=y
CONFIG_DEFAULT_BBR=y
CONFIG_DEFAULT_TCP_CONG="bbr"

# NET
# CONFIG_DEFAULT_FQ is not set
# CONFIG_DEFAULT_FQ_CODEL is not set
CONFIG_DEFAULT_CAKE=y
CONFIG_NET_SCH_CAKE=y
CONFIG_DEFAULT_NET_SCH="cake"

# Selinux Status
CONFIG_SECURITY_SELINUX_ALWAYS_ENFORCE=y
# CONFIG_SECURITY_SELINUX_ALWAYS_PERMISSIVE is not set

# Others
CONFIG_WQ_POWER_EFFICIENT_DEFAULT=y
# CONFIG_SCHED_CASS is not set
CONFIG_NOMOUNT=y
# CONFIG_DIRECT_RECLAIM_FILE_PAGES_ONLY is not set
# CONFIG_MEMCG_FORCE_USE_VM_SWAPPINESS is not set
# CONFIG_CFI_CLANG is not set
# CONFIG_CFI_CLANG_SHADOW is not set
# CONFIG_RELR is not set
```
